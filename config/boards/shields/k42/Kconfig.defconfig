## config/boards/shields/k42/Kconfig.defconfig
```kconfig
if SHIELD_K42_LEFT

config ZMK_KEYBOARD_NAME
    default "K42"

config ZMK_SPLIT_ROLE_CENTRAL
    default y

endif

if SHIELD_K42_LEFT || SHIELD_K42_RIGHT

config ZMK_SPLIT
    default y

config I2C
    default y

config SSD1306
    default y

endif
```

## config/boards/shields/k42/Kconfig.shield
```kconfig
config SHIELD_K42_LEFT
    def_bool $(shields_list_contains,k42_left)

config SHIELD_K42_RIGHT
    def_bool $(shields_list_contains,k42_right)
```
